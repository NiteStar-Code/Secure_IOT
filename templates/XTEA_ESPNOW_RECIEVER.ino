#include <esp_now.h>
#include <WiFi.h>

// --- Configuration ---
// MUST match the key used in the transmitter!
const uint8_t xtea_key[16] = {{KEY_C}};

// --- 1. XTEA Block Decryption Core (Inverse of Encryption) ---
void xtea_block_decrypt(unsigned int num_rounds, uint8_t v[8], const uint8_t k[16]) {
    uint32_t v0 = ((uint32_t)v[0] << 24) | ((uint32_t)v[1] << 16) | ((uint32_t)v[2] << 8) | v[3];
    uint32_t v1 = ((uint32_t)v[4] << 24) | ((uint32_t)v[5] << 16) | ((uint32_t)v[6] << 8) | v[7];
    
    uint32_t key[4];
    for (int i = 0; i < 4; i++) {
        key[i] = ((uint32_t)k[i*4] << 24) | ((uint32_t)k[i*4+1] << 16) | ((uint32_t)k[i*4+2] << 8) | k[i*4+3];
    }

    uint32_t delta = 0x9E3779B9;
    uint32_t sum = delta * num_rounds;
    for (unsigned int i = 0; i < num_rounds; i++) {
        v1 -= (((v0 << 4) ^ (v0 >> 5)) + v0) ^ (sum + key[(sum >> 11) & 3]);
        sum -= delta;
        v0 -= (((v1 << 4) ^ (v1 >> 5)) + v1) ^ (sum + key[sum & 3]);
    }

    v[0] = (v0 >> 24) & 0xFF; v[1] = (v0 >> 16) & 0xFF; v[2] = (v0 >> 8) & 0xFF; v[3] = v0 & 0xFF;
    v[4] = (v1 >> 24) & 0xFF; v[5] = (v1 >> 16) & 0xFF; v[6] = (v1 >> 8) & 0xFF; v[7] = v1 & 0xFF;
}

// Helper to convert a single hex character to a byte
uint8_t hex2bin(char c) {
    if (c >= '0' && c <= '9') return c - '0';
    if (c >= 'A' && c <= 'F') return c - 'A' + 10;
    if (c >= 'a' && c <= 'f') return c - 'a' + 10;
    return 0;
}

// --- 2. Full Decryption Function ---
String decryptXtea(String hexInput, const uint8_t key[16]) {
    size_t hexLen = hexInput.length();
    // Payload must contain at least the 8-byte IV (16 hex chars) and be a multiple of 16 (8 byte blocks)
    if (hexLen < 16 || hexLen % 16 != 0) return "Error: Invalid payload length";

    size_t binLen = hexLen / 2;
    uint8_t* binData = new uint8_t[binLen];
    
    // Convert Hex String to Binary Array
    for(size_t i = 0; i < binLen; i++) {
        binData[i] = (hex2bin(hexInput[i*2]) << 4) | hex2bin(hexInput[i*2+1]);
    }

    uint8_t feedback[8];
    memcpy(feedback, binData, 8); // The first 8 bytes are the IV generated by the transmitter

    size_t ctLen = binLen - 8; // Remaining bytes are ciphertext
    uint8_t* plaintext = new uint8_t[ctLen + 1]; // +1 for null terminator
    memset(plaintext, 0, ctLen + 1);

    // CBC Decryption Loop
    for (size_t i = 0; i < ctLen; i += 8) {
        uint8_t current_block[8];
        uint8_t next_feedback[8];
        
        memcpy(current_block, binData + 8 + i, 8);
        memcpy(next_feedback, current_block, 8); // Save ciphertext block to XOR with the *next* block

        // 1. Decrypt the block
        xtea_block_decrypt(32, current_block, key);

        // 2. XOR with the previous block (or IV for the first block)
        for(int b = 0; b < 8; b++) {
            current_block[b] ^= feedback[b];
        }

        // 3. Save to plaintext buffer and setup feedback for next round
        memcpy(plaintext + i, current_block, 8);
        memcpy(feedback, next_feedback, 8);
    }

    String result = String((char*)plaintext);
    
    delete[] binData;
    delete[] plaintext;
    
    return result; // The XTEA padding (null bytes) will naturally act as a string terminator!
}

// --- 3. ESP-NOW Receive Callback ---
void OnDataRecv(const uint8_t * mac, const uint8_t *incomingData, int len) {
    // 1. Format incoming raw bytes into a safe String
    char* buf = new char[len + 1];
    memcpy(buf, incomingData, len);
    buf[len] = '\0'; 
    String encryptedHex = String(buf);
    delete[] buf; // Free memory

    Serial.println("=============================");
    Serial.println("Received Encrypted (Hex): " + encryptedHex);
    
    // 2. Decrypt the message
    String decryptedText = decryptXtea(encryptedHex, xtea_key);
    
    // 3. Output the result
    Serial.println("Decrypted Value: " + decryptedText);
    Serial.println("=============================\n");
}

void setup() {
  Serial.begin(115200);
  
  // ESP-NOW requires Station Mode
  WiFi.mode(WIFI_STA);
  Serial.println("Device MAC Address: " + WiFi.macAddress());

  // Initialize ESP-NOW
  if (esp_now_init() != ESP_OK) {
    Serial.println("Error initializing ESP-NOW");
    return;
  }

  // Register the receive callback
  esp_now_register_recv_cb(esp_now_recv_cb_t(OnDataRecv));
  
  Serial.println("Receiver Ready. Waiting for XTEA encrypted data...");
}

void loop() {
  // ESP-NOW uses interrupts, so the loop can stay empty
  delay(1000);
}